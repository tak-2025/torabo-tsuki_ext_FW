/*
 * torabo-trackpad-live-ext — v2, RIGHT extender pad (store device 1).
 * Replaces the fixed per-layer children of pointing_listener_ext with the
 * runtime, store-driven tp_pointer (axis path) + tp_keys (tap/gesture path) as
 * the listener BASE processors, so edits in Torabo-Studio take effect live.
 *
 * Use AFTER input-trackpad-ext (which defines pointing_listener_ext), INSTEAD of
 * the fixed torabo-trackpad:
 *   -S "... input-trackpad-ext ... torabo-trackpad-live-ext ..."
 *
 * `behaviors` are the runtime binding-synthesis references (binding.h), in the
 * fixed order <&none>, <&kp>, <&mo>, <&to>, <&tog>; the app assigns any keycode/
 * consumer/layer per axis-swipe and per gesture. zip_temp_layer keeps
 * auto-mouse-layer on move. tp_pointer sees REL only, tp_keys KEY only.
 */

#include <input/processors.dtsi>
#include <dt-bindings/zmk/keys.h>

/ {
    tp_pointer_right: tp_pointer_right {
        compatible = "zmk,input-processor-tp-pointer";
        #input-processor-cells = <0>;
        device-id = <1>;
        behaviors = <&none>, <&kp 0>, <&mo 0>, <&to 0>, <&tog 0>;
    };
    tp_keys_right: tp_keys_right {
        compatible = "zmk,input-processor-tp-keys";
        #input-processor-cells = <0>;
        device-id = <1>;
        behaviors = <&none>, <&kp 0>, <&mo 0>, <&to 0>, <&tog 0>;
    };
};

&pointing_listener_ext {
    /delete-node/ scroll_vertical;
    /delete-node/ scroll_horizontal;
    /delete-node/ mouse_mode;
    input-processors = <&tp_pointer_right>, <&tp_keys_right>, <&zip_temp_layer 1 500>;
};

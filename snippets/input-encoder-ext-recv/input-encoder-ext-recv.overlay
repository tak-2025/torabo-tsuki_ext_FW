#include <dt-bindings/zmk/keys.h>

/*
 * central 受け口: 相手(peripheral)側の拡張FPCエンコーダの分割センサーを受ける。
 * デバイスは status=disabled（central では回さない）。sensors ノードだけ okay にして
 * keymap-sensors の LEN と sensor_index を central に確保する。
 * 物理側 input-encoder-ext とノード名・並びを一致させること。
 * エンコーダが central 自身に載るなら不要（そちらは input-encoder-ext 単体）。
 */

/ {
    ext_encoder: encoder_ext {
        compatible = "alps,ec11";
        a-gpios = <&gpio0 17 (GPIO_ACTIVE_HIGH | GPIO_PULL_UP)>;
        b-gpios = <&gpio0 21 (GPIO_ACTIVE_HIGH | GPIO_PULL_UP)>;
        steps = <80>;
        status = "disabled";
    };

    sensors: sensors {
        compatible = "zmk,keymap-sensors";
        sensors = <&ext_encoder>;
        triggers-per-rotation = <20>;
        status = "okay";
    };
};

/* 静的な既定割当（central 側で適用）: 回転で音量 ±。物理側と同じ既定に揃える。 */
/* Path reference, not &layer_0: the keymap declares the layer as a node NAME,
 * not a label, so there is nothing for &layer_0 to resolve to. */
&{/keymap/layer_0} {
    sensor-bindings = <&inc_dec_kp C_VOL_UP C_VOL_DN>;
};

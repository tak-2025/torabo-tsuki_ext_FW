## live_feed/Kconfig
```kconfig
menuconfig ZMK_LIVE_FEED
    bool "Live key/layer feed over BLE NOTIFY (Torabo-Float)"
    depends on BT && (!ZMK_SPLIT || ZMK_SPLIT_ROLE_CENTRAL)
    default n
    help
      Push a small packed event on every key press/release and layer change over a
      dedicated NOTIFY GATT service (e1f4af00), so a desktop overlay (Torabo-Float)
      can show which key is being pressed and which layer is active in real time.

      CENTRAL-only: only the central knows the layer state and the global key
      position. The push is fire-and-forget and only fires while a client has
      subscribed the CCC, so an unused build pays nothing. See Torabo-Float/PLAN.md.

      Default n; enable per build target with the torabo-live-feed snippet.

if ZMK_LIVE_FEED

config ZMK_LIVE_FEED_TUNNEL
    bool "Expose the live feed over the Studio RPC torabo tunnel"
    depends on ZMK_STUDIO_TORABO_TUNNEL
    default y
    help
      Also push the feed through the torabo tunnel (feature id 0x0F), so a Float
      connected over USB receives the same 16-byte records as a BLE subscriber.
      Key/layer and diagnostic records share one stream here; evt_type already
      tells them apart. Pushes only happen while a client has sent SUBSCRIBE, and
      that subscription is dropped when the client becomes unreachable, so an
      unused build still pays nothing.

config ZMK_LIVE_FEED_PREF_LATENCY
    int "Preferred peripheral latency while a client is subscribed"
    default 10
    help
      Connection latency requested when a client subscribes the feed. The default
      peripheral latency batches notifications into a laggy burst; a lower value is
      requested on subscribe and restored on unsubscribe (mirrors the Studio RPC
      transport). Only requested when this is below CONFIG_BT_PERIPHERAL_PREF_LATENCY.

config ZMK_LIVE_FEED_THREAD_STACK_SIZE
    int "Live feed notify thread stack size"
    default 1536 if ZMK_LIVE_FEED_TUNNEL
    default 1024
    help
      Stack for the dedicated live_feed work queue thread. This thread owns the
      bt_gatt_notify() call, which blocks (K_FOREVER) when the ACL TX buffers are
      exhausted, and also runs compute_keymap_crc(). Sized like ZMK's own BLE
      notify thread (CONFIG_ZMK_BLE_THREAD_STACK_SIZE, the HOG send queue) with a
      little extra headroom for the CRC walk.

      With the tunnel on, the same thread also encodes a protobuf Notification
      and runs nanopb's encoder, hence the higher default.

config ZMK_LIVE_FEED_THREAD_PRIORITY
    int "Live feed notify thread priority"
    default 10
    help
      Priority of the dedicated live_feed work queue thread. A preemptible, low
      priority (matching ZMK's low-priority work queue used by RGB/battery) keeps
      this best-effort overlay feature from ever preempting key scanning, HID, or
      split traffic; when its bt_gatt_notify() blocks it only pends itself.

config ZMK_LIVE_FEED_DIAG_HEARTBEAT_MS
    int "Diagnostic heartbeat interval (ms)"
    default 750
    help
      Diagnostic mode (per-device liveness on the second characteristic e1f4af02,
      PLAN-torabo-float.md §13) ships with the live feed. On-change records are cheap
      and always sent; a periodic heartbeat runs only while a client opts in (writes
      1 to e1f4af02), re-sending every device's record this often so the app can show
      "N ms ago" freshness and pick up the encoder counters (which have no input-event
      hook). Only runs while a client has it enabled, so a normal user pays nothing.

module = ZMK_LIVE_FEED
module-str = ZMK Live Feed
source "subsys/logging/Kconfig.template.log_config"

endif # ZMK_LIVE_FEED
```

## status_led_ext/Kconfig
```kconfig
menuconfig TORABO_STATUS_LED_EXT
    bool "3-colour extender status LED (BLE profile + split link)"
    depends on ZMK_BLE
    help
      Drive the 3-colour LED on the bmp-boost LED extender (right/central half):
      flash the active BLE profile's colour combo on a profile change, and hold
      red while the left (peripheral) split link is down. Requires the
      torabo-status-led-ext snippet, which defines the tsle_red / tsle_yg /
      tsle_grn gpio nodes. Central-only by nature; harmless elsewhere.
      Default n; enable per build target.

if TORABO_STATUS_LED_EXT

config TORABO_STATUS_LED_EXT_SHOW_MS
    int "Profile-change display duration (ms)"
    default 1500
    help
      How long the profile colour combo stays lit after a profile switch before
      the LED returns to idle (off, or red if the left link is down).

endif # TORABO_STATUS_LED_EXT
```

## trackpad/Kconfig
```kconfig
menuconfig ZMK_TRACKPAD_CONFIG
    bool "Runtime-configurable trackpad settings (torabo-tsuki)"
    help
      Per-layer, per-device trackpad behavior (move / scroll / off + the discrete
      encoder roles volume / brightness / zoom / browser + direction + step)
      editable at runtime over BLE. Milestone 1 provides the fail-open store and
      its BLE settings window only; the fixed torabo-trackpad overlay still drives
      behavior until the tp_pointer/tp_encoder input path is wired (milestone 2).
      Default n; enable per build target.

if ZMK_TRACKPAD_CONFIG

config ZMK_TRACKPAD_CONFIG_BLE
    bool "Expose trackpad settings over a BLE GATT service"
    depends on BT
    default y
    help
      Custom encrypted GATT service (e1f4ac00) to read/write the settings live.
      The v2 wire can exceed one ATT MTU, so enable CONFIG_BT_ATT_PREPARE_COUNT
      (>0) in the build so the GATT window can reassemble a Write Long.

config ZMK_TRACKPAD_CONFIG_TUNNEL
    bool "Expose the trackpad settings over the Studio RPC torabo tunnel"
    depends on ZMK_STUDIO_TORABO_TUNNEL
    default y
    help
      Register the settings with the torabo tunnel so they are reachable over
      whichever transport Studio RPC is using (USB serial included).
      Carries the exact same wire blob as the GATT service (feature id 0x0C), and
      coexists with it. No reassembly here: RPC delivers a whole message. A wire
      larger than CONFIG_ZMK_STUDIO_TORABO_TUNNEL_BLOB_MAX_SIZE (4 devices at 20
      layers encodes 3054 B) is refused rather than truncated; raise it there.

config ZMK_TRACKPAD_CONFIG_DEV0_META
    int "Device 0 identity metadata byte"
    default 0
    range 0 255
    help
      Identity of wire device 0 (the pointing device the peripheral exports over
      split), encoded as TP_META(side, conn, kind) — see config.h. The app renders
      its label from this instead of guessing from the device id, so the same app
      works for every hardware pattern (central on either half, pad on the board's
      own FFC or on the extender, etc).

      The firmware builder emits this per configuration. Leave 0 (unknown) to have
      the app fall back to a generic "device 0" label.

config ZMK_TRACKPAD_CONFIG_DEV1_META
    int "Device 1 identity metadata byte"
    default 0
    range 0 255
    help
      Identity of wire device 1 (the central's extender pad). See DEV0_META.

config ZMK_TRACKPAD_CONFIG_DEV2_META
    int "Device 2 identity metadata byte"
    default 0
    range 0 255
    help
      Identity of wire device 2, if a build ever exposes a third device. See
      DEV0_META.

config ZMK_TRACKPAD_CONFIG_DEV3_META
    int "Device 3 identity metadata byte"
    default 0
    range 0 255
    help
      Identity of wire device 3, if a build ever exposes a fourth device. See
      DEV0_META.

config ZMK_TRACKPAD_CONFIG_DTAP_WINDOW_MS
    int "Double-tap detection window (ms) for tp_keys gestures"
    default 250
    range 0 1000
    help
      Time window used by the tp_keys gesture processor (DESIGN-trackpad-v2.md
      §4.4) to detect a double tap. A single tap is deferred by this window ONLY
      when a double-tap binding is assigned for the active layer/device, so the
      added latency applies only when double-tap is actually configured.

module = ZMK_TRACKPAD_CONFIG
module-str = ZMK Trackpad Config
source "subsys/logging/Kconfig.template.log_config"

endif # ZMK_TRACKPAD_CONFIG
```

## caps/Kconfig
```kconfig
menuconfig TORABO_CAPS
    bool "Torabo capability descriptor (firmware self-description)"
    default n
    help
      Expose "what can this firmware do?" to Torabo-Studio: the firmware version,
      which feature modules were compiled in, each one's wire version, and
      per-feature capability bits.

      A build is assembled from snippets, so two keyboards running the same app can
      have completely different feature sets. Rather than have the app guess (or
      probe every GATT service and see which ones fail), the firmware names itself
      once on connect and the app shows only the tabs that exist.

      Enable on the CENTRAL — it is the half the app talks to.

if TORABO_CAPS

config TORABO_CAPS_BLE
    bool "Expose the descriptor over a BLE GATT service"
    depends on BT
    default y
    help
      Read-only GATT service e1f4a000. Nothing to write: it describes the build.

config TORABO_FW_VERSION_MAJOR
    int "Torabo firmware version: major"
    default 0

config TORABO_FW_VERSION_MINOR
    int "Torabo firmware version: minor"
    default 1

config TORABO_FW_VERSION_PATCH
    int "Torabo firmware version: patch"
    default 0

module = TORABO_CAPS
module-str = Torabo Caps
source "subsys/logging/Kconfig.template.log_config"

endif # TORABO_CAPS
```

## combos/Kconfig
```kconfig
menuconfig ZMK_DYNAMIC_COMBOS
    bool "Dynamic (NVS-backed, live-editable) combos for torabo-tsuki"
    help
      Runtime-editable combos: a set of key positions pressed together fires one
      behavior (key press / layer / dynamic macro). Definitions live in NVS and
      are edited live over BLE, so changing a combo never needs a reflash.

      This replaces the upstream (devicetree-const) combo engine with a literal
      copy whose definition array is RAM-backed. It is the SINGLE owner of the
      position-combo listener: do NOT also instantiate a "zmk,combos" node
      (the upstream combo.c stays inert when that node is absent). Fail-safe:
      empty/invalid/disabled combos never capture a key, so normal typing is
      unaffected.

if ZMK_DYNAMIC_COMBOS

config ZMK_DYNAMIC_COMBOS_BLE
    bool "Expose dynamic-combo config over a BLE GATT service"
    depends on BT
    default y
    help
      Custom encrypted GATT service: READ returns all combo slots (Read Blob),
      WRITE updates one combo at a time (small enough to fit a single ATT write,
      so no long-write is needed).

config ZMK_DYNAMIC_COMBOS_TUNNEL
    bool "Expose the dynamic-combo config over the Studio RPC torabo tunnel"
    depends on ZMK_STUDIO_TORABO_TUNNEL
    default y
    help
      Register the settings with the torabo tunnel so they are reachable over
      whichever transport Studio RPC is using (USB serial included).
      Carries the exact same READ/WRITE wire blobs as the GATT service (feature
      id 0x0B), and coexists with it.

module = ZMK_DYNAMIC_COMBOS
module-str = ZMK Dynamic Combos
source "subsys/logging/Kconfig.template.log_config"

endif # ZMK_DYNAMIC_COMBOS
```

## dts/bindings/behaviors/torabo,behavior-encoder-config.yaml
```yaml
description: |
  Rotary encoder rotation router (torabo-tsuki).

  A ZMK sensor behavior whose clockwise / counter-clockwise actions are NOT fixed
  in devicetree: it resolves them from the runtime encoder store for the layer the
  event arrived on, so they can be edited live from the app. The keymap therefore
  holds a single immutable entry:

      sensor-bindings = <&enc_cfg>;

  Unassigned on a layer => transparent, so a lower layer can act.

compatible: "torabo,behavior-encoder-config"

properties:
  "#sensor-binding-cells":
    type: int
    required: true
    const: 0
  behaviors:
    type: phandle-array
    # ZMK behaviors expose #binding-cells, not #behavior-cells. Without this,
    # devicetree looks for #behavior-cells and every reference (starting with
    # &none) fails with "lacks #behavior-cells".
    specifier-space: binding
    required: true
    description: |
      Runtime binding-synthesis references, in this fixed order (binding.h):
      <&none>, <&kp 0>, <&mo 0>, <&to 0>, <&tog 0>. &kp doubles for both KP and
      CP (a consumer usage is &kp with the consumer usage page).
  tap-ms:
    type: int
    default: 5
    description: press-to-release gap for one detent, as in ZMK's own rotate behavior.

sensor-binding-cells: []
```

## dts/bindings/behaviors/torabo,behavior-led-ext.yaml
```yaml
description: |
  Peripheral-side LED receiver (torabo-tsuki).

  The central invokes this behavior over the split with the rendered LED state
  packed into param1 (colour mask | pattern << 8). The peripheral holds no rule
  table of its own — it just renders what it is told, plus a local fallback while
  the link is down (which is the one state the central cannot reach it in).

  KEEP THE NODE NAME SHORT: the split payload carries the behavior's device name
  in a char[16], and a longer name is silently truncated and then fails to resolve
  on this side. `led_ext` is 7 characters.

compatible: "torabo,behavior-led-ext"

properties:
  "#binding-cells":
    type: int
    required: true
    const: 0

binding-cells: []
```

## dts/bindings/behaviors/zmk,behavior-dynamic-macro.yaml
```yaml
# Copyright (c) 2026 tak-2025
# SPDX-License-Identifier: MIT

description: Dynamic (NVS-backed, live-editable) macro behavior

compatible: "zmk,behavior-dynamic-macro"

include: one_param.yaml
```

## dts/bindings/input_processors/torabo,input-processor-enc-button.yaml
```yaml
description: |
  Rotary encoder push-button router (torabo-tsuki).

  Picks up the INPUT_EV_KEY event a `gpio-keys` button emits and fires whatever the
  runtime encoder store assigns to the current layer's button, so the click is
  editable live from the app.

  Sits on the input listener for the button device. When the encoder is on the
  peripheral half, put the gpio-keys device behind `zmk,input-split` and place this
  processor on the central's listener — behaviors must be invoked on the half that
  talks to the host.

compatible: "torabo,input-processor-enc-button"

include: ip_zero_param.yaml

properties:
  code:
    type: int
    required: true
    description: |
      The INPUT_EV_KEY code the gpio-keys node emits for this button (its
      `zephyr,code`, e.g. INPUT_BTN_0). Events with any other code pass through.
  behaviors:
    type: phandle-array
    # See the behavior binding: `behaviors` needs the binding specifier space or
    # devicetree demands #behavior-cells and every reference fails.
    specifier-space: binding
    required: true
    description: |
      Runtime binding-synthesis references, in this fixed order (binding.h):
      <&none>, <&kp 0>, <&mo 0>, <&to 0>, <&tog 0>.
```

## dts/bindings/input_processors/zmk,input-processor-tp-keys.yaml
```yaml
# Copyright (c) 2026 tak-2025
# SPDX-License-Identifier: MIT

description: |
  Gesture-remap input processor (torabo-tsuki, v2). Sibling of tp-pointer, wired
  as a listener BASE processor on the same pointing listener. Consumes INPUT_EV_KEY
  (BTN_0 single tap, BTN_1 two-finger tap) and, for the device named by `device-id`
  and the active layer, fires the store's gesture binding (tap / tap2 / hold), with
  optional double-tap detection in a time window (§4.4). Fails open: an unset slot
  passes the driver's default click through (CONTINUE). Bindings are built at
  runtime from `behaviors` (same references and order as tp-pointer).

compatible: "zmk,input-processor-tp-keys"

include: ip_zero_param.yaml

properties:
  device-id:
    type: int
    required: true
    description: which trackpad store device this instance drives (0=left, 1=right ext).
  behaviors:
    type: phandle-array
    # ZMK behaviors expose #binding-cells, not #behavior-cells. Without this,
    # the property name `behaviors` makes devicetree look for #behavior-cells and
    # every ref (starting with &none) fails "lacks #behavior-cells".
    specifier-space: binding
    required: true
    description: |
      Runtime binding-synthesis references, in this fixed order (binding.h):
      <&none>, <&kp 0>, <&mo 0>, <&to 0>, <&tog 0>. &kp doubles for both the KP
      and CP behaviors (a consumer usage is &kp with the consumer usage page).
```

## dts/bindings/input_processors/zmk,input-processor-tp-pointer.yaml
```yaml
# Copyright (c) 2026 tak-2025
# SPDX-License-Identifier: MIT

description: |
  Device-aware configurable trackpad processor (torabo-tsuki, v2). Wired as the
  input listener BASE processor; for the device named by `device-id` it reads the
  runtime per-layer per-axis role/direction/step from the trackpad store and
  always fails open to plain move.
    continuous roles (move/scroll/off) pass through (scroll remaps to WHEEL);
    the ENCODER role accumulates the axis and fires the per-axis pos/neg binding
    (from the store) every `step` units, consuming the axis. The bindings are
    built at runtime from `behaviors` (see below), so any keycode is assignable.

compatible: "zmk,input-processor-tp-pointer"

include: ip_zero_param.yaml

properties:
  device-id:
    type: int
    required: true
    description: which trackpad store device this instance drives (0=left, 1=right ext).
  behaviors:
    type: phandle-array
    # ZMK behaviors expose #binding-cells, not #behavior-cells. Without this,
    # the property name `behaviors` makes devicetree look for #behavior-cells and
    # every ref (starting with &none) fails "lacks #behavior-cells".
    specifier-space: binding
    required: true
    description: |
      Runtime binding-synthesis references, in this fixed order (binding.h):
      <&none>, <&kp 0>, <&mo 0>, <&to 0>, <&tog 0>. &kp doubles for both the KP
      and CP behaviors (a consumer usage is &kp with the consumer usage page).
```

## dts/bindings/input_processors/zmk,input-processor-ztc-encoder.yaml
```yaml
# Copyright (c) 2026 tak-2025
# SPDX-License-Identifier: MIT

description: |
  Encoder-style input processor (torabo-tsuki). Accumulates one relative axis and
  taps a behavior every `threshold` units: bindings[0] for the +direction,
  bindings[1] for the -direction. Consumes the matched axis so it does not also
  move the cursor. Assigned per layer via the listener's per-layer children.

compatible: "zmk,input-processor-ztc-encoder"

include: ip_zero_param.yaml

properties:
  type:
    type: int
    description: input event type to match (default INPUT_EV_REL).
  code:
    type: int
    required: true
    description: relative axis code to accumulate (e.g. INPUT_REL_Y).
  threshold:
    type: int
    description: units of motion per tap (bigger = coarser; default 8).
  bindings:
    type: phandle-array
    required: true
    description: exactly two behaviors <positive>, <negative>.
```

## dts/bindings/input_processors/zmk,input-processor-ztc-pointer.yaml
```yaml
# Copyright (c) 2026 tak-2025
# SPDX-License-Identifier: MIT

description: |
  Configurable per-axis pointing processor (torabo-tsuki). Wired as the input
  listener BASE processor; applies runtime per-layer per-axis role/direction/speed
  from the ztc store, always fail-open to plain move. Takes no cells.

compatible: "zmk,input-processor-ztc-pointer"

include: ip_zero_param.yaml
```

## dts/bindings/input_processors/zmk,input-processor-ztc-temp-layer.yaml
```yaml
# Copyright (c) 2024 The ZMK Contributors (base) / 2026 tak-2025
# SPDX-License-Identifier: MIT

description: |
  Verbatim copy of zmk,input-processor-temp-layer with target+timeout sourced
  from the runtime ztc store (param1/param2 are DT fallbacks). Replaces the stock
  zip_temp_layer so it is the single owner of temp-layer state.

compatible: "zmk,input-processor-ztc-temp-layer"

include: ip_two_param.yaml

properties:
  require-prior-idle-ms:
    type: int
    required: false
    default: 0
    description: Time in ms after the last keystroke before the layer can be toggled
  excluded-positions:
    type: array
    required: false
    default: []
    description: Key positions that will NOT trigger layer deactivation when pressed
```

## dts/bindings/zmk,dynamic-combos.yaml
```yaml
# Copyright (c) 2026 tak-2025
# SPDX-License-Identifier: MIT

description: |
  Marker node that activates the dynamic (NVS-backed, live-editable) combo
  engine. A singleton; it has no properties. Its presence is what makes
  combo_engine.c compile (DT_HAS_COMPAT_STATUS_OKAY). Do NOT also add a
  "zmk,combos" node — the dynamic engine is the single owner of the combo
  position listener.

compatible: "zmk,dynamic-combos"
```

## encoder/Kconfig
```kconfig
menuconfig ZMK_ENCODER_CONFIG
    bool "Runtime-configurable rotary encoder (torabo-tsuki)"
    help
      Per-layer assignments for a rotary encoder — clockwise, counter-clockwise
      and the push button — editable live over BLE from Torabo-Studio.

      The encoder is not a keymap key: rotation rides ZMK's sensor path and the
      button rides the input path, and both resolve what to fire from this store.
      That is why an encoder needs no matrix transform, no physical-layout entry
      and no keymap edits.

      Default n; enable per build target (see the torabo-encoder-live snippet).

if ZMK_ENCODER_CONFIG

config ZMK_ENCODER_CONFIG_BLE
    bool "Expose the encoder settings over a BLE GATT service"
    depends on BT
    default y
    help
      Encrypted GATT service e1f4ad00 to read/write the assignments live. The
      config is ~124 B, so it fits in a single ATT write and needs no Write Long.

config ZMK_ENCODER_CONFIG_TUNNEL
    bool "Expose the encoder settings over the Studio RPC torabo tunnel"
    depends on ZMK_STUDIO_TORABO_TUNNEL
    default y
    help
      Register the settings with the torabo tunnel so they are reachable over
      whichever transport Studio RPC is using (USB serial included).
      Carries the exact same wire blob as the GATT service (feature id 0x0D), and
      coexists with it.

module = ZMK_ENCODER_CONFIG
module-str = ZMK Encoder Config
source "subsys/logging/Kconfig.template.log_config"

endif # ZMK_ENCODER_CONFIG
```

## features/macros/Kconfig
```kconfig
menuconfig ZMK_DYNAMIC_KEYMAP
    bool "Dynamic (NVS-backed, live-editable) macros for torabo-tsuki"
    help
      Runtime-editable macros invoked via &dmac <slot>. The slot contents are
      stored in NVS and edited live over BLE, so changing a macro never needs a
      reflash. Fail-safe: empty/invalid slots simply do nothing. Phase 1 =
      macros; combos are a planned Phase 2 in the same module.

if ZMK_DYNAMIC_KEYMAP

config ZMK_DYNAMIC_KEYMAP_BLE
    bool "Expose dynamic-keymap config over a BLE GATT service"
    depends on BT
    default y
    help
      Custom encrypted GATT service: READ returns all macro slots (Read Blob),
      WRITE updates one slot at a time (small enough to fit a single ATT write,
      so no long-write is needed).

config ZMK_DYNAMIC_KEYMAP_TUNNEL
    bool "Expose the dynamic-keymap config over the Studio RPC torabo tunnel"
    depends on ZMK_STUDIO_TORABO_TUNNEL
    default y
    help
      Register the settings with the torabo tunnel so they are reachable over
      whichever transport Studio RPC is using (USB serial included).
      Carries the exact same READ/WRITE wire blobs as the GATT service (feature
      id 0x0A), and coexists with it.

config ZMK_DYNAMIC_KEYMAP_STEP_TAP_MS
    int "Per-step tap duration (ms) for TAP steps"
    default 2

config ZMK_DYNAMIC_KEYMAP_STEP_GAP_MS
    int "Inter-step gap (ms)"
    default 2

module = ZMK_DYNAMIC_KEYMAP
module-str = ZMK Dynamic Keymap
source "subsys/logging/Kconfig.template.log_config"

endif # ZMK_DYNAMIC_KEYMAP
```
